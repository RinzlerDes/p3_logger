/**
 ******************************************************************************
 * @file    oled.c
 * @brief   Text driver for the 0.96" 128x64 OLED (SSD1315 on SPI1) —
 *          HAL port of the course driver (provided).
 *
 *          SWEN 563 / CMPE 663 — P2 "DG-30 DecuGuard" starter.
 *          PROVIDED DRIVER — do not change it.
 *
 *  Compare this driver with the P1 oled.c. The SSD1315 command sequence is
 *  byte-for-byte the same, and only the data path changed. P1 wrote to
 *  SPI1->DR and polled the SR flags. This driver calls HAL_SPI_Transmit()
 *  on the CubeMX-generated handle. This driver does not initialize the GPIO
 *  or the SPI. MX_GPIO_Init() and MX_SPI1_Init() own that work (refer to
 *  the .ioc).
 *
 *  Pins (CubeMX labels): PH0 = CS_DISP, PC9 = D/C_DISP, PC8 = RST_DISP,
 *  SPI1 = PA1 SCK / PA7 MOSI, 8-bit, 8 MHz, CPOL=1/CPHA=0 (mode 2, which
 *  agrees with the ST BSP and the P1 register driver).
 ******************************************************************************
 */
#include <stdarg.h>
#include <stdio.h>
#include "main.h"
#include "oled.h"

extern SPI_HandleTypeDef hspi1;          /* CubeMX-generated (main.c)     */

#define OLED_PAGE_BYTES 128u
#define SPI_TMO_MS       50u

static uint8_t oled_up;                  /* init guard                    */

/* 5x7 font, ASCII 0x20..0x7E — same public-domain glyph set as P0/P1. */
static const uint8_t font5x7[95][5] = {
    {0x00,0x00,0x00,0x00,0x00}, {0x00,0x00,0x5F,0x00,0x00},
    {0x00,0x07,0x00,0x07,0x00}, {0x14,0x7F,0x14,0x7F,0x14},
    {0x24,0x2A,0x7F,0x2A,0x12}, {0x23,0x13,0x08,0x64,0x62},
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    {0x02,0x01,0x02,0x04,0x02},
};

static inline void cs_low(void)   { HAL_GPIO_WritePin(CS_DISP_GPIO_Port,  CS_DISP_Pin,  GPIO_PIN_RESET); }
static inline void cs_high(void)  { HAL_GPIO_WritePin(CS_DISP_GPIO_Port,  CS_DISP_Pin,  GPIO_PIN_SET);   }
static inline void dc_low(void)   { HAL_GPIO_WritePin(D_C_DISP_GPIO_Port, D_C_DISP_Pin, GPIO_PIN_RESET); }
static inline void dc_high(void)  { HAL_GPIO_WritePin(D_C_DISP_GPIO_Port, D_C_DISP_Pin, GPIO_PIN_SET);   }
static inline void rst_low(void)  { HAL_GPIO_WritePin(RST_DISP_GPIO_Port, RST_DISP_Pin, GPIO_PIN_RESET); }
static inline void rst_high(void) { HAL_GPIO_WritePin(RST_DISP_GPIO_Port, RST_DISP_Pin, GPIO_PIN_SET);   }

static void oled_cmd(uint8_t c)
{
    cs_low();
    dc_low();
    HAL_SPI_Transmit(&hspi1, &c, 1u, SPI_TMO_MS);
    cs_high();
}

static void oled_data(const uint8_t *p, uint16_t len)
{
    cs_low();
    dc_high();
    HAL_SPI_Transmit(&hspi1, (uint8_t *)p, len, SPI_TMO_MS);
    dc_low();
    cs_high();
}

/* Page window = row..row, column window = 0..127 (horizontal addressing). */
static void oled_set_row_window(uint8_t row)
{
    oled_cmd(0x22u); oled_cmd(row);  oled_cmd(row);
    oled_cmd(0x21u); oled_cmd(0x00u); oled_cmd(0x7Fu);
}

void oled_init(void)
{
    cs_high();
    dc_low();

    rst_low();
    HAL_Delay(1u);                       /* init-time only — R22 exempts init */
    rst_high();
    HAL_Delay(100u);

    oled_cmd(0xAEu);            /* display off               */
    oled_cmd(0x8Du);            /* charge-pump ...           */
    oled_cmd(0x14u);            /* ... enable                */
    oled_cmd(0x20u);            /* memory addressing mode... */
    oled_cmd(0x00u);            /* ... horizontal            */
    oled_cmd(0x40u);            /* display start line 0      */
    oled_cmd(0xC8u);            /* COM scan: remapped        */
    oled_cmd(0xA1u);            /* segment remap             */
    oled_cmd(0xAFu);            /* display on                */

    oled_up = 1u;
    oled_clear();
}

void oled_clear(void)
{
    uint8_t zeros[OLED_PAGE_BYTES] = {0u};

    if (oled_up == 0u) {
        return;
    }
    for (uint8_t row = 0u; row < OLED_ROWS; row++) {
        oled_set_row_window(row);
        oled_data(zeros, sizeof zeros);
    }
}

void oled_write_line(uint8_t row, const char *text)
{
    uint8_t line[OLED_PAGE_BYTES];
    uint32_t x = 0u;

    if (oled_up == 0u || row >= OLED_ROWS || text == NULL) {
        return;
    }
    for (uint32_t col = 0u; col < OLED_COLS; col++) {
        char c = (*text != '\0') ? *text++ : ' ';
        const uint8_t *glyph = (c >= 0x20 && c <= 0x7E)
                               ? font5x7[c - 0x20] : font5x7[0];
        for (uint32_t i = 0u; i < 5u; i++) {
            line[x++] = glyph[i];
        }
        line[x++] = 0x00u;
    }
    while (x < OLED_PAGE_BYTES) {
        line[x++] = 0x00u;
    }
    oled_set_row_window(row);
    oled_data(line, sizeof line);
}

void oled_printf(uint8_t row, const char *fmt, ...)
{
    char buf[OLED_COLS + 1u];
    va_list ap;

    va_start(ap, fmt);
    vsnprintf(buf, sizeof buf, fmt, ap);
    va_end(ap);
    oled_write_line(row, buf);
}
